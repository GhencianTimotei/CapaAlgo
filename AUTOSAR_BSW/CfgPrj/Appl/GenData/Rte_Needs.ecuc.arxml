AUTOSAR XML (schema 4-0-3)
package /DaVinci_Project
  module config Rte
    21 x RteBswModuleInstance:
      Adc
      Can
        3 x RteBswEventToTaskMapping:
          Can_MainFunction_BusOffTimingEvent0
          Can_MainFunction_ModeTimingEvent0
          Can_MainFunction_WakeupTimingEvent0
      CanIf
      CanSM
        CanSM_MainFunctionTimingEvent0 (RteBswEventToTaskMapping)
      CanTp
        CanTp_MainFunctionTimingEvent0 (RteBswEventToTaskMapping)
      Com
        Com_MainFunctionRxTimingEvent0 (RteBswEventToTaskMapping)
        Com_MainFunctionTxTimingEvent0 (RteBswEventToTaskMapping)
      ComM
        ComM_MainFunction_0TimingEvent0 (RteBswEventToTaskMapping): RteBswUsedOsEventRef=Rte_Ev_Cyclic2_Task_10ms_0_20ms, RteBswUsedOsAlarmRef=Os/Rte_Al_TE2_Task_10ms_0_20ms
      Dcm
        Dcm_MainFunctionTimingEvent0 (RteBswEventToTaskMapping): RteBswUsedOsEventRef=Rte_Ev_Cyclic2_Task_10ms_0_10ms, RteBswUsedOsAlarmRef=Os/Rte_Al_TE2_Task_10ms_0_10ms
      Dem
        Dem_MasterMainFunctionTimingEvent0 (RteBswEventToTaskMapping): RteBswUsedOsEventRef=Rte_Ev_Cyclic2_Task_10ms_0_12500us, RteBswUsedOsAlarmRef=Os/Rte_Al_TE2_Task_10ms_0_12500us
        Dem_SatelliteMainFunctionTimingEvent0 (RteBswEventToTaskMapping): RteBswUsedOsEventRef=Rte_Ev_Cyclic2_Task_10ms_0_12500us, RteBswUsedOsAlarmRef=Os/Rte_Al_TE2_Task_10ms_0_12500us
      Det
      Dio
      Fls
        Fls_MainFunctionTimingEvent0 (RteBswEventToTaskMapping)
      Gpt
      I2c
      Icu
      Mcl
      Mcu
      NvM
        NvM_MainFunctionTimingEvent0 (RteBswEventToTaskMapping): RteBswUsedOsEventRef=Rte_Ev_Cyclic2_Task_10ms_0_10ms, RteBswUsedOsAlarmRef=Os/Rte_Al_TE2_Task_10ms_0_10ms
      PduR
      Port
      Pwm
    8 x RteSwComponentInstance:
      ComM_EcuSwComposition
        Timer_ComM_MainFunction_0 (RteEventToTaskMapping): RteUsedOsEventRef=Rte_Ev_Cyclic2_Task_10ms_0_20ms, RteUsedOsAlarmRef=Os/Rte_Al_TE2_Task_10ms_0_20ms
      Dcm_EcuSwComposition
        Timer_Dcm_MainFunction (RteEventToTaskMapping): RteUsedOsEventRef=Rte_Ev_Cyclic2_Task_10ms_0_10ms, RteUsedOsAlarmRef=Os/Rte_Al_TE2_Task_10ms_0_10ms
      DemMaster_0_EcuSwComposition
        Timer_Dem_MasterMainFunction (RteEventToTaskMapping): RteUsedOsEventRef=Rte_Ev_Cyclic2_Task_10ms_0_12500us, RteUsedOsAlarmRef=Os/Rte_Al_TE2_Task_10ms_0_12500us
      DemSatellite_0_EcuSwComposition
        Timer_Dem_SatelliteMainFunction (RteEventToTaskMapping): RteUsedOsEventRef=Rte_Ev_Cyclic2_Task_10ms_0_12500us, RteUsedOsAlarmRef=Os/Rte_Al_TE2_Task_10ms_0_12500us
      Det_EcuSwComposition
      NvM_EcuSwComposition
        Timer_NvM_MainFunction (RteEventToTaskMapping): RteUsedOsEventRef=Rte_Ev_Cyclic2_Task_10ms_0_10ms, RteUsedOsAlarmRef=Os/Rte_Al_TE2_Task_10ms_0_10ms
      Os_OsCore0_swc_EcuSwComposition
      vDem42_EcuSwComposition
    RteOsInteraction
      3 x RteUsedOsActivation, all with RteExpectedActivationOffset=0, RteActivationOsTaskRef=Task_10ms:
        Rte_Al_TE2_Task_10ms_0_10ms: RteActivationOsAlarmRef=Os/Rte_Al_TE2_Task_10ms_0_10ms
        Rte_Al_TE2_Task_10ms_0_12500us: RteActivationOsAlarmRef=Os/Rte_Al_TE2_Task_10ms_0_12500us
        Rte_Al_TE2_Task_10ms_0_20ms: RteActivationOsAlarmRef=Os/Rte_Al_TE2_Task_10ms_0_20ms
  module config NvM
  module config Os
    Task_10ms (OsTask):
      OsTaskActivation = 1
      OsTaskPriority = 8
      OsTaskSchedule = NON
      OsTaskEventRef = Rte_Ev_Cyclic2_Task_10ms_0_10ms
      OsTaskEventRef = Rte_Ev_Cyclic2_Task_10ms_0_12500us
      OsTaskEventRef = Rte_Ev_Cyclic2_Task_10ms_0_20ms
    3 x OsAlarm:
      Rte_Al_TE2_Task_10ms_0_10ms: OsAlarmCounterRef=OsCounter
        OsAlarmAction
          OsAlarmSetEvent: OsAlarmSetEventRef=Rte_Ev_Cyclic2_Task_10ms_0_10ms, OsAlarmSetEventTaskRef=Task_10ms
      Rte_Al_TE2_Task_10ms_0_12500us: OsAlarmCounterRef=SystemTimer
        OsAlarmAction
          OsAlarmSetEvent: OsAlarmSetEventRef=Rte_Ev_Cyclic2_Task_10ms_0_12500us, OsAlarmSetEventTaskRef=Task_10ms
      Rte_Al_TE2_Task_10ms_0_20ms: OsAlarmCounterRef=SystemTimer
        OsAlarmAction
          OsAlarmSetEvent: OsAlarmSetEventRef=Rte_Ev_Cyclic2_Task_10ms_0_20ms, OsAlarmSetEventTaskRef=Task_10ms
    3 x OsEvent:
      Rte_Ev_Cyclic2_Task_10ms_0_10ms
      Rte_Ev_Cyclic2_Task_10ms_0_12500us
      Rte_Ev_Cyclic2_Task_10ms_0_20ms
  module config EcuC
  ecuc value collection DaVinci_Project: ecuc-values=[Com, Rte, Os, EcuC, NvM]
